## demo/fireware/main/Kconfig.projbuild
```kconfig
menu "BusSpy OLED demo"

config WIFI_AP_PASSWORD
    string "Wi-Fi setup hotspot password (8-63 characters)"
    default "88888888"
    help
        Set a WPA2 passphrase for the BusSpy-S3 setup hotspot.

config RGB_LED_GPIO
    int "Onboard WS2812 GPIO"
    range 0 48
    default 48

config RGB_LED_BRIGHTNESS
    int "RGB LED brightness (0-255)"
    range 1 255
    default 12

endmenu
```
